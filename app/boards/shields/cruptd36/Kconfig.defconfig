## app/boards/shields/cruptd36/Kconfig.defconfig
```kconfig
if SHIELD_CRUPTD36_LEFT

config ZMK_KEYBOARD_NAME
    default "cruptd36"

config ZMK_SPLIT_ROLE_CENTRAL
    default y

endif

if SHIELD_CRUPTD36_RIGHT

config ZMK_KEYBOARD_NAME
    default "cruptd36"

endif

if SHIELD_CRUPTD36_LEFT || SHIELD_CRUPTD36_RIGHT

config ZMK_SPLIT
    default y

endif
```

## app/boards/shields/cruptd36/Kconfig.shield
```kconfig
config SHIELD_CRUPTD36_LEFT
    def_bool $(shields_list_contains,cruptd36_left)

config SHIELD_CRUPTD36_RIGHT  
    def_bool $(shields_list_contains,cruptd36_right)
```

## app/west.yml
```yaml
manifest:
  remotes:
    - name: zephyrproject-rtos
      url-base: https://github.com/zephyrproject-rtos
    - name: zmkfirmware
      url-base: https://github.com/zmkfirmware
    - name: george-norton
      url-base: https://github.com/george-norton
  projects:
    - name: zephyr
      remote: zmkfirmware
      revision: v3.5.0+zmk-fixes
      clone-depth: 1
      import:
        name-blocklist:
          - ci-tools
          - hal_altera
          - hal_cypress
          - hal_infineon
          - hal_microchip
          - hal_nxp
          - hal_openisa
          - hal_silabs
          - hal_xtensa
          - hal_st
          - hal_ti
          - loramac-node
          - mcuboot
          - mcumgr
          - net-tools
          - openthread
          - edtt
          - trusted-firmware-m
    - name: nanopb
      revision: 8c60555d6277a0360c876bd85d491fc4fb0cd74a
      path: modules/lib/nanopb
      remote: zmkfirmware
    - name: zmk-studio-messages
      revision: 6cb4c283e76209d59c45fbcb218800cd19e9339d
      path: modules/msgs/zmk-studio-messages
      remote: zmkfirmware
    - name: zmk-driver-pmw3360
      remote: george-norton
      revision: main
      path: modules/drivers/zmk-driver-pmw3360
  self:
    west-commands: scripts/west-commands.yml
```
